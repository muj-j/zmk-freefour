## boards/shields/freefour/Kconfig.defconfig
```kconfig
if SHIELD_FREEFOUR_LEFT

# Name must be less than 16 characters long!
config ZMK_KEYBOARD_NAME
    default "freefour"

config ZMK_SPLIT_ROLE_CENTRAL
    default y

endif

if SHIELD_FREEFOUR_LEFT || SHIELD_FREEFOUR_RIGHT

config ZMK_SPLIT
    default y

endif
```

## boards/shields/freefour/Kconfig.shield
```kconfig
# No whitespace after the comma or in your part name!
config SHIELD_FREEFOUR
    def_bool $(shields_list_contains,freefour)

# No whitespace after the comma or in your part name!
config SHIELD_FREEFOUR_DONGLE
    def_bool $(shields_list_contains,freefour_dongle)
```
